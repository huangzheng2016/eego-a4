// SPDX-License-Identifier: GPL-3.0-or-later
// GENERATED by `python3 firmware/tools/preset_tool.py embed` from firmware/presets/.
// Do not edit; validate_firmware.py / preset_tool.py validate-library fail when stale.
// Served by GET /api/v1/dashboard/templates straight from flash.
constexpr char kDashboardTemplatesJson[] = R"EEGOTPL({"schema":"eego.dashboard-template-library/1","schema_version":1,
"grid_rows_per_screen":8,
"presets":[
{"schema":"eego.dashboard-preset/1","schema_version":1,"id":"metric-single","kind":"panel","title":"Single metric","description":"Large current value with optional delta and thresholds.","dashboard":{"sources":[{"id":"metrics","kind":"http","enabled":true,"url":"http://${mock_host}/metrics","refresh_ms":60000,"timeout_ms":10000,"max_response_bytes":65536,"tls_verify":true,"auth_token_ref":"","headers":{}}],"variables":[{"name":"mock_host","label":"Mock host:port","kind":"text","default_value":"127.0.0.1:8978","options":[],"source_id":"","value_path":"","multi":false,"include_all":false}],"pages":[{"id":"main","title":"Overview","visible":true,"grid_columns":24,"panels":[{"id":"value","kind":"card","grid":{"x":0,"y":0,"w":24,"h":8},"title":"Current value","visible":true,"refresh_ms":60000,"source_id":"metrics","metric":"metric.value","style":{"variant":"default","precision":1},"thresholds":[{"value":80,"severity":"warning","label":"High"},{"value":95,"severity":"critical","label":"Critical"}]}]}],"alert_rules":[],"assets":[],"samples":[],"events":[]},"source_plans":[{"id":"metrics","kind":"http","enabled":true,"url":"http://${mock_host}/metrics","refresh_ms":60000,"timeout_ms":10000,"max_response_bytes":65536,"tls_verify":true,"auth_token_ref":"","headers":{},"response":"standard_json","method":"GET","body":"","static_body":"","text_path":"","reset_at_path":"$.reset_at","stale_after_ms":300000,"conditional_get":true,"max_json_depth":16}]},
{"schema":"eego.dashboard-preset/1","schema_version":1,"id":"metric-dual","kind":"panel","title":"Dual metric","description":"One dual card with a linked independent metric series.","dashboard":{"sources":[{"id":"metrics","kind":"http","enabled":true,"url":"http://${mock_host}/metrics","refresh_ms":60000,"timeout_ms":10000,"max_response_bytes":65536,"tls_verify":true,"auth_token_ref":"","headers":{}}],"variables":[{"name":"mock_host","label":"Mock host:port","kind":"text","default_value":"127.0.0.1:8978","options":[],"source_id":"","value_path":"","multi":false,"include_all":false}],"pages":[{"id":"main","title":"Overview","visible":true,"grid_columns":24,"panels":[{"id":"primary_value","kind":"card","grid":{"x":0,"y":0,"w":24,"h":8},"title":"Two metrics","visible":true,"refresh_ms":60000,"source_id":"metrics","metric":"metric.value","style":{"variant":"dual","precision":1},"linked_panel_ids":["secondary_value"]},{"id":"secondary_value","kind":"card","grid":{"x":0,"y":0,"w":1,"h":1},"title":"Secondary","visible":false,"refresh_ms":60000,"source_id":"metrics","metric":"metric.secondary","style":{"variant":"default","precision":1}}]}],"alert_rules":[],"assets":[],"samples":[],"events":[]},"source_plans":[{"id":"metrics","kind":"http","enabled":true,"url":"http://${mock_host}/metrics","refresh_ms":60000,"timeout_ms":10000,"max_response_bytes":65536,"tls_verify":true,"auth_token_ref":"","headers":{},"response":"standard_json","method":"GET","body":"","static_body":"","text_path":"","reset_at_path":"$.reset_at","stale_after_ms":300000,"conditional_get":true,"max_json_depth":16}]},
{"schema":"eego.dashboard-preset/1","schema_version":1,"id":"metric-triple","kind":"panel","title":"Triple metric","description":"One triple card with two linked independent metric series.","dashboard":{"sources":[{"id":"metrics","kind":"http","enabled":true,"url":"http://${mock_host}/metrics","refresh_ms":60000,"timeout_ms":10000,"max_response_bytes":65536,"tls_verify":true,"auth_token_ref":"","headers":{}}],"variables":[{"name":"mock_host","label":"Mock host:port","kind":"text","default_value":"127.0.0.1:8978","options":[],"source_id":"","value_path":"","multi":false,"include_all":false}],"pages":[{"id":"main","title":"Overview","visible":true,"grid_columns":24,"panels":[{"id":"primary_value","kind":"card","grid":{"x":0,"y":0,"w":24,"h":8},"title":"Three metrics","visible":true,"refresh_ms":60000,"source_id":"metrics","metric":"metric.value","style":{"variant":"triple","precision":1},"linked_panel_ids":["secondary_value","tertiary_value"]},{"id":"secondary_value","kind":"card","grid":{"x":0,"y":0,"w":1,"h":1},"title":"Secondary","visible":false,"refresh_ms":60000,"source_id":"metrics","metric":"metric.secondary","style":{"variant":"default","precision":1}},{"id":"tertiary_value","kind":"card","grid":{"x":0,"y":0,"w":1,"h":1},"title":"Tertiary","visible":false,"refresh_ms":60000,"source_id":"metrics","metric":"metric.tertiary","style":{"variant":"default","precision":1}}]}],"alert_rules":[],"assets":[],"samples":[],"events":[]},"source_plans":[{"id":"metrics","kind":"http","enabled":true,"url":"http://${mock_host}/metrics","refresh_ms":60000,"timeout_ms":10000,"max_response_bytes":65536,"tls_verify":true,"auth_token_ref":"","headers":{},"response":"standard_json","method":"GET","body":"","static_body":"","text_path":"","reset_at_path":"$.reset_at","stale_after_ms":300000,"conditional_get":true,"max_json_depth":16}]},
{"schema":"eego.dashboard-preset/1","schema_version":1,"id":"progress","kind":"panel","title":"Progress","description":"Zero-to-one-hundred progress bar with threshold coloring.","dashboard":{"sources":[{"id":"metrics","kind":"http","enabled":true,"url":"http://${mock_host}/metrics","refresh_ms":60000,"timeout_ms":10000,"max_response_bytes":65536,"tls_verify":true,"auth_token_ref":"","headers":{}}],"variables":[{"name":"mock_host","label":"Mock host:port","kind":"text","default_value":"127.0.0.1:8978","options":[],"source_id":"","value_path":"","multi":false,"include_all":false}],"pages":[{"id":"main","title":"Overview","visible":true,"grid_columns":24,"panels":[{"id":"progress","kind":"card","grid":{"x":0,"y":0,"w":24,"h":8},"title":"Completion","visible":true,"refresh_ms":60000,"source_id":"metrics","metric":"progress.percent","style":{"variant":"progress","precision":0,"unit":"%"},"thresholds":[{"value":90,"severity":"warning","label":"Near limit"}]}]}],"alert_rules":[],"assets":[],"samples":[],"events":[]},"source_plans":[{"id":"metrics","kind":"http","enabled":true,"url":"http://${mock_host}/metrics","refresh_ms":60000,"timeout_ms":10000,"max_response_bytes":65536,"tls_verify":true,"auth_token_ref":"","headers":{},"response":"standard_json","method":"GET","body":"","static_body":"","text_path":"","reset_at_path":"$.reset_at","stale_after_ms":300000,"conditional_get":true,"max_json_depth":16}]},
{"schema":"eego.dashboard-preset/1","schema_version":1,"id":"line-chart","kind":"panel","title":"Line chart","description":"Time-windowed line chart with points and legend.","dashboard":{"sources":[{"id":"metrics","kind":"http","enabled":true,"url":"http://${mock_host}/metrics","refresh_ms":60000,"timeout_ms":10000,"max_response_bytes":65536,"tls_verify":true,"auth_token_ref":"","headers":{}}],"variables":[{"name":"mock_host","label":"Mock host:port","kind":"text","default_value":"127.0.0.1:8978","options":[],"source_id":"","value_path":"","multi":false,"include_all":false}],"pages":[{"id":"main","title":"Overview","visible":true,"grid_columns":24,"panels":[{"id":"line","kind":"chart","grid":{"x":0,"y":0,"w":24,"h":8},"title":"Line chart","visible":true,"refresh_ms":60000,"source_id":"metrics","metric":"series.value","chart":{"kind":"line","show_points":true,"fill":false,"y_min":null,"y_max":null},"style":{"unit":"","precision":1,"line_width":2,"show_legend":true},"time_window":{"from":"-1h","to":"now"}}]}],"alert_rules":[],"assets":[],"samples":[],"events":[]},"source_plans":[{"id":"metrics","kind":"http","enabled":true,"url":"http://${mock_host}/metrics","refresh_ms":60000,"timeout_ms":10000,"max_response_bytes":65536,"tls_verify":true,"auth_token_ref":"","headers":{},"response":"standard_json","method":"GET","body":"","static_body":"","text_path":"","reset_at_path":"$.reset_at","stale_after_ms":300000,"conditional_get":true,"max_json_depth":16}]},
{"schema":"eego.dashboard-preset/1","schema_version":1,"id":"area-chart","kind":"panel","title":"Area chart","description":"Filled line chart; fill is the existing chart rendering option.","dashboard":{"sources":[{"id":"metrics","kind":"http","enabled":true,"url":"http://${mock_host}/metrics","refresh_ms":60000,"timeout_ms":10000,"max_response_bytes":65536,"tls_verify":true,"auth_token_ref":"","headers":{}}],"variables":[{"name":"mock_host","label":"Mock host:port","kind":"text","default_value":"127.0.0.1:8978","options":[],"source_id":"","value_path":"","multi":false,"include_all":false}],"pages":[{"id":"main","title":"Overview","visible":true,"grid_columns":24,"panels":[{"id":"area","kind":"chart","grid":{"x":0,"y":0,"w":24,"h":8},"title":"Area chart","visible":true,"refresh_ms":60000,"source_id":"metrics","metric":"series.value","chart":{"kind":"line","show_points":false,"fill":true,"y_min":0,"y_max":null},"style":{"unit":"","precision":1,"line_width":2,"show_legend":true},"time_window":{"from":"-1h","to":"now"}}]}],"alert_rules":[],"assets":[],"samples":[],"events":[]},"source_plans":[{"id":"metrics","kind":"http","enabled":true,"url":"http://${mock_host}/metrics","refresh_ms":60000,"timeout_ms":10000,"max_response_bytes":65536,"tls_verify":true,"auth_token_ref":"","headers":{},"response":"standard_json","method":"GET","body":"","static_body":"","text_path":"","reset_at_path":"$.reset_at","stale_after_ms":300000,"conditional_get":true,"max_json_depth":16}]},
{"schema":"eego.dashboard-preset/1","schema_version":1,"id":"bar-chart","kind":"panel","title":"Bar chart","description":"Time-windowed bars with a zero baseline.","dashboard":{"sources":[{"id":"metrics","kind":"http","enabled":true,"url":"http://${mock_host}/metrics","refresh_ms":60000,"timeout_ms":10000,"max_response_bytes":65536,"tls_verify":true,"auth_token_ref":"","headers":{}}],"variables":[{"name":"mock_host","label":"Mock host:port","kind":"text","default_value":"127.0.0.1:8978","options":[],"source_id":"","value_path":"","multi":false,"include_all":false}],"pages":[{"id":"main","title":"Overview","visible":true,"grid_columns":24,"panels":[{"id":"bars","kind":"chart","grid":{"x":0,"y":0,"w":24,"h":8},"title":"Bar chart","visible":true,"refresh_ms":60000,"source_id":"metrics","metric":"series.value","chart":{"kind":"bar","show_points":false,"fill":false,"y_min":0,"y_max":null},"style":{"unit":"","precision":1,"line_width":2,"show_legend":true},"time_window":{"from":"-1h","to":"now"}}]}],"alert_rules":[],"assets":[],"samples":[],"events":[]},"source_plans":[{"id":"metrics","kind":"http","enabled":true,"url":"http://${mock_host}/metrics","refresh_ms":60000,"timeout_ms":10000,"max_response_bytes":65536,"tls_verify":true,"auth_token_ref":"","headers":{},"response":"standard_json","method":"GET","body":"","static_body":"","text_path":"","reset_at_path":"$.reset_at","stale_after_ms":300000,"conditional_get":true,"max_json_depth":16}]},
{"schema":"eego.dashboard-preset/1","schema_version":1,"id":"sparkline","kind":"panel","title":"Sparkline","description":"Compact line without a legend, using at most 128 plot points.","dashboard":{"sources":[{"id":"metrics","kind":"http","enabled":true,"url":"http://${mock_host}/metrics","refresh_ms":60000,"timeout_ms":10000,"max_response_bytes":65536,"tls_verify":true,"auth_token_ref":"","headers":{}}],"variables":[{"name":"mock_host","label":"Mock host:port","kind":"text","default_value":"127.0.0.1:8978","options":[],"source_id":"","value_path":"","multi":false,"include_all":false}],"pages":[{"id":"main","title":"Overview","visible":true,"grid_columns":24,"panels":[{"id":"sparkline","kind":"chart","grid":{"x":0,"y":0,"w":24,"h":8},"title":"Sparkline","visible":true,"refresh_ms":60000,"source_id":"metrics","metric":"series.value","chart":{"kind":"sparkline","show_points":false,"fill":false,"y_min":null,"y_max":null},"style":{"unit":"","precision":1,"line_width":2,"show_legend":false},"time_window":{"from":"-1h","to":"now"}}]}],"alert_rules":[],"assets":[],"samples":[],"events":[]},"source_plans":[{"id":"metrics","kind":"http","enabled":true,"url":"http://${mock_host}/metrics","refresh_ms":60000,"timeout_ms":10000,"max_response_bytes":65536,"tls_verify":true,"auth_token_ref":"","headers":{},"response":"standard_json","method":"GET","body":"","static_body":"","text_path":"","reset_at_path":"$.reset_at","stale_after_ms":300000,"conditional_get":true,"max_json_depth":16}]},
{"schema":"eego.dashboard-preset/1","schema_version":1,"id":"table","kind":"panel","title":"Table","description":"Metric rows with mapped labels, values, and timestamps.","dashboard":{"sources":[{"id":"metrics","kind":"http","enabled":true,"url":"http://${mock_host}/metrics","refresh_ms":60000,"timeout_ms":10000,"max_response_bytes":65536,"tls_verify":true,"auth_token_ref":"","headers":{}}],"variables":[{"name":"mock_host","label":"Mock host:port","kind":"text","default_value":"127.0.0.1:8978","options":[],"source_id":"","value_path":"","multi":false,"include_all":false}],"pages":[{"id":"main","title":"Overview","visible":true,"grid_columns":24,"panels":[{"id":"records","kind":"table","grid":{"x":0,"y":0,"w":24,"h":8},"title":"Metric table","visible":true,"refresh_ms":60000,"source_id":"metrics","metric":"table.value","columns":[{"key":"name","title":"Name","width":8},{"key":"value","title":"Value","width":5},{"key":"status","title":"Status","width":6},{"key":"timestamp_ms","title":"Timestamp","width":8}],"style":{"variant":"default","precision":1}}]}],"alert_rules":[],"assets":[],"samples":[],"events":[]},"source_plans":[{"id":"metrics","kind":"http","enabled":true,"url":"http://${mock_host}/metrics","refresh_ms":60000,"timeout_ms":10000,"max_response_bytes":65536,"tls_verify":true,"auth_token_ref":"","headers":{},"response":"standard_json","method":"GET","body":"","static_body":"","text_path":"","reset_at_path":"$.reset_at","stale_after_ms":300000,"conditional_get":true,"max_json_depth":16}]},
{"schema":"eego.dashboard-preset/1","schema_version":1,"id":"key-value","kind":"panel","title":"Key / value text","description":"Server-normalized key/value text; no device-side scripting.","dashboard":{"sources":[{"id":"text","kind":"http","enabled":true,"url":"http://${mock_host}/text?scenario=key_value","refresh_ms":60000,"timeout_ms":10000,"max_response_bytes":65536,"tls_verify":true,"auth_token_ref":"","headers":{}}],"variables":[{"name":"mock_host","label":"Mock host:port","kind":"text","default_value":"127.0.0.1:8978","options":[],"source_id":"","value_path":"","multi":false,"include_all":false}],"pages":[{"id":"main","title":"Overview","visible":true,"grid_columns":24,"panels":[{"id":"key_values","kind":"text","grid":{"x":0,"y":0,"w":24,"h":8},"title":"Key / value","visible":true,"refresh_ms":60000,"text":{"content":"Loading key values…","multiline":true,"max_lines":8},"style":{"variant":"key_value"},"source_id":"text","metric":"text"}]}],"alert_rules":[],"assets":[],"samples":[],"events":[]},"source_plans":[{"id":"text","kind":"http","enabled":true,"url":"http://${mock_host}/text?scenario=key_value","refresh_ms":60000,"timeout_ms":10000,"max_response_bytes":65536,"tls_verify":true,"auth_token_ref":"","headers":{},"response":"text","method":"GET","body":"","static_body":"","text_path":"","reset_at_path":"$.reset_at","stale_after_ms":300000,"conditional_get":true,"max_json_depth":16}]},
{"schema":"eego.dashboard-preset/1","schema_version":1,"id":"log-tail","kind":"panel","title":"Log tail","description":"Remote multiline log tail, bounded to eight lines and 4096 code points.","dashboard":{"sources":[{"id":"text","kind":"http","enabled":true,"url":"http://${mock_host}/text?scenario=log","refresh_ms":60000,"timeout_ms":10000,"max_response_bytes":65536,"tls_verify":true,"auth_token_ref":"","headers":{}}],"variables":[{"name":"mock_host","label":"Mock host:port","kind":"text","default_value":"127.0.0.1:8978","options":[],"source_id":"","value_path":"","multi":false,"include_all":false}],"pages":[{"id":"main","title":"Overview","visible":true,"grid_columns":24,"panels":[{"id":"logs","kind":"text","grid":{"x":0,"y":0,"w":24,"h":8},"title":"Log tail","visible":true,"refresh_ms":60000,"text":{"content":"Loading logs…","multiline":true,"max_lines":8},"style":{"variant":"log_tail"},"source_id":"text","metric":"text"}]}],"alert_rules":[],"assets":[],"samples":[],"events":[]},"source_plans":[{"id":"text","kind":"http","enabled":true,"url":"http://${mock_host}/text?scenario=log","refresh_ms":60000,"timeout_ms":10000,"max_response_bytes":65536,"tls_verify":true,"auth_token_ref":"","headers":{},"response":"text","method":"GET","body":"","static_body":"","text_path":"","reset_at_path":"$.reset_at","stale_after_ms":300000,"conditional_get":true,"max_json_depth":16}]},
{"schema":"eego.dashboard-preset/1","schema_version":1,"id":"event-stream","kind":"panel","title":"Event stream","description":"Active first, then newest events using the native alert renderer.","dashboard":{"sources":[{"id":"events","kind":"http","enabled":true,"url":"http://${mock_host}/events","refresh_ms":60000,"timeout_ms":10000,"max_response_bytes":65536,"tls_verify":true,"auth_token_ref":"","headers":{}}],"variables":[{"name":"mock_host","label":"Mock host:port","kind":"text","default_value":"127.0.0.1:8978","options":[],"source_id":"","value_path":"","multi":false,"include_all":false}],"pages":[{"id":"main","title":"Overview","visible":true,"grid_columns":24,"panels":[{"id":"event_stream","kind":"alert","grid":{"x":0,"y":0,"w":24,"h":8},"title":"Event stream","visible":true,"refresh_ms":60000,"text":{"content":"No alerts","multiline":false,"max_lines":1}}]}],"alert_rules":[],"assets":[],"samples":[],"events":[]},"source_plans":[{"id":"events","kind":"http","enabled":true,"url":"http://${mock_host}/events","refresh_ms":60000,"timeout_ms":10000,"max_response_bytes":65536,"tls_verify":true,"auth_token_ref":"","headers":{},"response":"standard_json","method":"GET","body":"","static_body":"","text_path":"","reset_at_path":"$.reset_at","stale_after_ms":300000,"conditional_get":true,"max_json_depth":16}]},
{"schema":"eego.dashboard-preset/1","schema_version":1,"id":"alert-count","kind":"panel","title":"Alert count","description":"Large count from a generic alerts.active metric supplied by the source.","dashboard":{"sources":[{"id":"events","kind":"http","enabled":true,"url":"http://${mock_host}/events","refresh_ms":60000,"timeout_ms":10000,"max_response_bytes":65536,"tls_verify":true,"auth_token_ref":"","headers":{}}],"variables":[{"name":"mock_host","label":"Mock host:port","kind":"text","default_value":"127.0.0.1:8978","options":[],"source_id":"","value_path":"","multi":false,"include_all":false}],"pages":[{"id":"main","title":"Overview","visible":true,"grid_columns":24,"panels":[{"id":"alert_count","kind":"card","grid":{"x":0,"y":0,"w":24,"h":8},"title":"Active alerts","visible":true,"refresh_ms":60000,"source_id":"events","metric":"alerts.active","style":{"variant":"default","precision":0},"thresholds":[{"value":1,"severity":"warning","label":"Active"},{"value":5,"severity":"critical","label":"High"}]}]}],"alert_rules":[],"assets":[],"samples":[],"events":[]},"source_plans":[{"id":"events","kind":"http","enabled":true,"url":"http://${mock_host}/events","refresh_ms":60000,"timeout_ms":10000,"max_response_bytes":65536,"tls_verify":true,"auth_token_ref":"","headers":{},"response":"standard_json","method":"GET","body":"","static_body":"","text_path":"","reset_at_path":"$.reset_at","stale_after_ms":300000,"conditional_get":true,"max_json_depth":16}]},
{"schema":"eego.dashboard-preset/1","schema_version":1,"id":"alert-banner","kind":"panel","title":"Alert banner","description":"Two-row alert surface for the newest active events.","dashboard":{"sources":[{"id":"events","kind":"http","enabled":true,"url":"http://${mock_host}/events","refresh_ms":60000,"timeout_ms":10000,"max_response_bytes":65536,"tls_verify":true,"auth_token_ref":"","headers":{}}],"variables":[{"name":"mock_host","label":"Mock host:port","kind":"text","default_value":"127.0.0.1:8978","options":[],"source_id":"","value_path":"","multi":false,"include_all":false}],"pages":[{"id":"main","title":"Overview","visible":true,"grid_columns":24,"panels":[{"id":"alert_banner","kind":"alert","grid":{"x":0,"y":0,"w":24,"h":2},"title":"Alert banner","visible":true,"refresh_ms":60000,"text":{"content":"All clear","multiline":false,"max_lines":1}},{"id":"banner_note","kind":"text","grid":{"x":0,"y":2,"w":24,"h":6},"title":"Banner semantics","visible":true,"refresh_ms":60000,"text":{"content":"The compact native alert panel shows the newest active event first.","multiline":true,"max_lines":4},"style":{"variant":"description"}}]}],"alert_rules":[],"assets":[],"samples":[],"events":[]},"source_plans":[{"id":"events","kind":"http","enabled":true,"url":"http://${mock_host}/events","refresh_ms":60000,"timeout_ms":10000,"max_response_bytes":65536,"tls_verify":true,"auth_token_ref":"","headers":{},"response":"standard_json","method":"GET","body":"","static_body":"","text_path":"","reset_at_path":"$.reset_at","stale_after_ms":300000,"conditional_get":true,"max_json_depth":16}]},
{"schema":"eego.dashboard-preset/1","schema_version":1,"id":"alert-table","kind":"panel","title":"Alert table","description":"Full-height severity/title/state rows with cleared events ordered last.","dashboard":{"sources":[{"id":"events","kind":"http","enabled":true,"url":"http://${mock_host}/events","refresh_ms":60000,"timeout_ms":10000,"max_response_bytes":65536,"tls_verify":true,"auth_token_ref":"","headers":{}}],"variables":[{"name":"mock_host","label":"Mock host:port","kind":"text","default_value":"127.0.0.1:8978","options":[],"source_id":"","value_path":"","multi":false,"include_all":false}],"pages":[{"id":"main","title":"Overview","visible":true,"grid_columns":24,"panels":[{"id":"alert_table","kind":"alert","grid":{"x":0,"y":0,"w":24,"h":8},"title":"Alert table","visible":true,"refresh_ms":60000,"text":{"content":"No alerts","multiline":false,"max_lines":1}}]}],"alert_rules":[],"assets":[],"samples":[],"events":[]},"source_plans":[{"id":"events","kind":"http","enabled":true,"url":"http://${mock_host}/events","refresh_ms":60000,"timeout_ms":10000,"max_response_bytes":65536,"tls_verify":true,"auth_token_ref":"","headers":{},"response":"standard_json","method":"GET","body":"","static_body":"","text_path":"","reset_at_path":"$.reset_at","stale_after_ms":300000,"conditional_get":true,"max_json_depth":16}]},
{"schema":"eego.dashboard-preset/1","schema_version":1,"id":"status-grid","kind":"panel","title":"Status grid","description":"Up to 32 labeled status cells with threshold-based severity.","dashboard":{"sources":[{"id":"metrics","kind":"http","enabled":true,"url":"http://${mock_host}/metrics","refresh_ms":60000,"timeout_ms":10000,"max_response_bytes":65536,"tls_verify":true,"auth_token_ref":"","headers":{}}],"variables":[{"name":"mock_host","label":"Mock host:port","kind":"text","default_value":"127.0.0.1:8978","options":[],"source_id":"","value_path":"","multi":false,"include_all":false}],"pages":[{"id":"main","title":"Overview","visible":true,"grid_columns":24,"panels":[{"id":"status_grid","kind":"table","grid":{"x":0,"y":0,"w":24,"h":8},"title":"Status grid","visible":true,"refresh_ms":60000,"source_id":"metrics","metric":"status.value","columns":[{"key":"name","title":"Name","width":8},{"key":"value","title":"Value","width":5}],"style":{"variant":"status_grid","precision":1},"thresholds":[{"value":1,"severity":"warning","label":"Degraded"},{"value":2,"severity":"critical","label":"Down"}]}]}],"alert_rules":[],"assets":[],"samples":[],"events":[]},"source_plans":[{"id":"metrics","kind":"http","enabled":true,"url":"http://${mock_host}/metrics","refresh_ms":60000,"timeout_ms":10000,"max_response_bytes":65536,"tls_verify":true,"auth_token_ref":"","headers":{},"response":"standard_json","method":"GET","body":"","static_body":"","text_path":"","reset_at_path":"$.reset_at","stale_after_ms":300000,"conditional_get":true,"max_json_depth":16}]},
{"schema":"eego.dashboard-preset/1","schema_version":1,"id":"heatmap","kind":"panel","title":"Heatmap","description":"Up to 64 numeric cells in an eight-column grayscale heatmap.","dashboard":{"sources":[{"id":"metrics","kind":"http","enabled":true,"url":"http://${mock_host}/metrics","refresh_ms":60000,"timeout_ms":10000,"max_response_bytes":65536,"tls_verify":true,"auth_token_ref":"","headers":{}}],"variables":[{"name":"mock_host","label":"Mock host:port","kind":"text","default_value":"127.0.0.1:8978","options":[],"source_id":"","value_path":"","multi":false,"include_all":false}],"pages":[{"id":"main","title":"Overview","visible":true,"grid_columns":24,"panels":[{"id":"heatmap","kind":"table","grid":{"x":0,"y":0,"w":24,"h":8},"title":"Heatmap","visible":true,"refresh_ms":60000,"source_id":"metrics","metric":"heatmap.value","columns":[{"key":"name","title":"Name","width":8},{"key":"value","title":"Value","width":5}],"style":{"variant":"heatmap","precision":1}}]}],"alert_rules":[],"assets":[],"samples":[],"events":[]},"source_plans":[{"id":"metrics","kind":"http","enabled":true,"url":"http://${mock_host}/metrics","refresh_ms":60000,"timeout_ms":10000,"max_response_bytes":65536,"tls_verify":true,"auth_token_ref":"","headers":{},"response":"standard_json","method":"GET","body":"","static_body":"","text_path":"","reset_at_path":"$.reset_at","stale_after_ms":300000,"conditional_get":true,"max_json_depth":16}]},
{"schema":"eego.dashboard-preset/1","schema_version":1,"id":"timeline","kind":"panel","title":"Timeline","description":"Up to 16 timestamped states on a horizontal timeline.","dashboard":{"sources":[{"id":"metrics","kind":"http","enabled":true,"url":"http://${mock_host}/metrics","refresh_ms":60000,"timeout_ms":10000,"max_response_bytes":65536,"tls_verify":true,"auth_token_ref":"","headers":{}}],"variables":[{"name":"mock_host","label":"Mock host:port","kind":"text","default_value":"127.0.0.1:8978","options":[],"source_id":"","value_path":"","multi":false,"include_all":false}],"pages":[{"id":"main","title":"Overview","visible":true,"grid_columns":24,"panels":[{"id":"timeline","kind":"table","grid":{"x":0,"y":0,"w":24,"h":8},"title":"Timeline","visible":true,"refresh_ms":60000,"source_id":"metrics","metric":"timeline.value","columns":[{"key":"name","title":"Name","width":8},{"key":"value","title":"Value","width":5}],"style":{"variant":"timeline","precision":1},"thresholds":[{"value":1,"severity":"warning","label":"Degraded"},{"value":2,"severity":"critical","label":"Down"}]}]}],"alert_rules":[],"assets":[],"samples":[],"events":[]},"source_plans":[{"id":"metrics","kind":"http","enabled":true,"url":"http://${mock_host}/metrics","refresh_ms":60000,"timeout_ms":10000,"max_response_bytes":65536,"tls_verify":true,"auth_token_ref":"","headers":{},"response":"standard_json","method":"GET","body":"","static_body":"","text_path":"","reset_at_path":"$.reset_at","stale_after_ms":300000,"conditional_get":true,"max_json_depth":16}]},
{"schema":"eego.dashboard-preset/1","schema_version":1,"id":"text-single","kind":"panel","title":"Single-line text","description":"Remote single-line text with variable-safe literal rendering.","dashboard":{"sources":[{"id":"text","kind":"http","enabled":true,"url":"http://${mock_host}/text","refresh_ms":60000,"timeout_ms":10000,"max_response_bytes":65536,"tls_verify":true,"auth_token_ref":"","headers":{}}],"variables":[{"name":"mock_host","label":"Mock host:port","kind":"text","default_value":"127.0.0.1:8978","options":[],"source_id":"","value_path":"","multi":false,"include_all":false}],"pages":[{"id":"main","title":"Overview","visible":true,"grid_columns":24,"panels":[{"id":"headline","kind":"text","grid":{"x":0,"y":0,"w":24,"h":8},"title":"Text","visible":true,"refresh_ms":60000,"text":{"content":"Loading text…","multiline":false,"max_lines":1},"style":{"variant":"single"},"source_id":"text","metric":"text"}]}],"alert_rules":[],"assets":[],"samples":[],"events":[]},"source_plans":[{"id":"text","kind":"http","enabled":true,"url":"http://${mock_host}/text","refresh_ms":60000,"timeout_ms":10000,"max_response_bytes":65536,"tls_verify":true,"auth_token_ref":"","headers":{},"response":"text","method":"GET","body":"","static_body":"","text_path":"","reset_at_path":"$.reset_at","stale_after_ms":300000,"conditional_get":true,"max_json_depth":16}]},
{"schema":"eego.dashboard-preset/1","schema_version":1,"id":"text-multiline","kind":"panel","title":"Multiline text","description":"Remote wrapped text, capped at eight lines in this preset.","dashboard":{"sources":[{"id":"text","kind":"http","enabled":true,"url":"http://${mock_host}/text","refresh_ms":60000,"timeout_ms":10000,"max_response_bytes":65536,"tls_verify":true,"auth_token_ref":"","headers":{}}],"variables":[{"name":"mock_host","label":"Mock host:port","kind":"text","default_value":"127.0.0.1:8978","options":[],"source_id":"","value_path":"","multi":false,"include_all":false}],"pages":[{"id":"main","title":"Overview","visible":true,"grid_columns":24,"panels":[{"id":"notes","kind":"text","grid":{"x":0,"y":0,"w":24,"h":8},"title":"Multiline text","visible":true,"refresh_ms":60000,"text":{"content":"Loading notes…","multiline":true,"max_lines":8},"style":{"variant":"multiline"},"source_id":"text","metric":"text"}]}],"alert_rules":[],"assets":[],"samples":[],"events":[]},"source_plans":[{"id":"text","kind":"http","enabled":true,"url":"http://${mock_host}/text","refresh_ms":60000,"timeout_ms":10000,"max_response_bytes":65536,"tls_verify":true,"auth_token_ref":"","headers":{},"response":"text","method":"GET","body":"","static_body":"","text_path":"","reset_at_path":"$.reset_at","stale_after_ms":300000,"conditional_get":true,"max_json_depth":16}]},
{"schema":"eego.dashboard-preset/1","schema_version":1,"id":"image","kind":"panel","title":"Image","description":"PNG image fetched through the existing asset/source pipeline.","dashboard":{"sources":[{"id":"image","kind":"http","enabled":true,"url":"http://${mock_host}/assets/status.png","refresh_ms":60000,"timeout_ms":10000,"max_response_bytes":65536,"tls_verify":true,"auth_token_ref":"","headers":{}}],"variables":[{"name":"mock_host","label":"Mock host:port","kind":"text","default_value":"127.0.0.1:8978","options":[],"source_id":"","value_path":"","multi":false,"include_all":false}],"pages":[{"id":"main","title":"Overview","visible":true,"grid_columns":24,"panels":[{"id":"status_image_panel","kind":"image","grid":{"x":0,"y":0,"w":24,"h":8},"title":"Image","visible":true,"refresh_ms":60000,"source_id":"image","metric":"image","image":{"asset_id":"status_image","alt_text":"Status image unavailable","fit":"contain"}}]}],"alert_rules":[],"assets":[{"id":"status_image","kind":"image","uri":"http://${mock_host}/assets/status.png","media_type":"image/png","sha256":"","size_bytes":0,"cache_seconds":300}],"samples":[],"events":[]},"source_plans":[{"id":"image","kind":"http","enabled":true,"url":"http://${mock_host}/assets/status.png","refresh_ms":60000,"timeout_ms":10000,"max_response_bytes":65536,"tls_verify":true,"auth_token_ref":"","headers":{},"response":"image","method":"GET","body":"","static_body":"","text_path":"","reset_at_path":"$.reset_at","stale_after_ms":300000,"conditional_get":true,"max_json_depth":16}]},
{"schema":"eego.dashboard-preset/1","schema_version":1,"id":"image-text","kind":"layout","title":"Image and text","description":"Side-by-side image and remotely mapped caption.","dashboard":{"sources":[{"id":"image","kind":"http","enabled":true,"url":"http://${mock_host}/assets/status.png","refresh_ms":60000,"timeout_ms":10000,"max_response_bytes":65536,"tls_verify":true,"auth_token_ref":"","headers":{}},{"id":"text","kind":"http","enabled":true,"url":"http://${mock_host}/text","refresh_ms":60000,"timeout_ms":10000,"max_response_bytes":65536,"tls_verify":true,"auth_token_ref":"","headers":{}}],"variables":[{"name":"mock_host","label":"Mock host:port","kind":"text","default_value":"127.0.0.1:8978","options":[],"source_id":"","value_path":"","multi":false,"include_all":false}],"pages":[{"id":"main","title":"Overview","visible":true,"grid_columns":24,"panels":[{"id":"status_image_panel","kind":"image","grid":{"x":0,"y":0,"w":10,"h":8},"title":"Status image","visible":true,"refresh_ms":60000,"source_id":"image","metric":"image","image":{"asset_id":"status_image","alt_text":"Image unavailable","fit":"contain"}},{"id":"image_caption","kind":"text","grid":{"x":10,"y":0,"w":14,"h":8},"title":"Caption","visible":true,"refresh_ms":60000,"text":{"content":"Loading caption…","multiline":true,"max_lines":8},"style":{"variant":"description"},"source_id":"text","metric":"text"}]}],"alert_rules":[],"assets":[{"id":"status_image","kind":"image","uri":"http://${mock_host}/assets/status.png","media_type":"image/png","sha256":"","size_bytes":0,"cache_seconds":300}],"samples":[],"events":[]},"source_plans":[{"id":"image","kind":"http","enabled":true,"url":"http://${mock_host}/assets/status.png","refresh_ms":60000,"timeout_ms":10000,"max_response_bytes":65536,"tls_verify":true,"auth_token_ref":"","headers":{},"response":"image","method":"GET","body":"","static_body":"","text_path":"","reset_at_path":"$.reset_at","stale_after_ms":300000,"conditional_get":true,"max_json_depth":16},{"id":"text","kind":"http","enabled":true,"url":"http://${mock_host}/text","refresh_ms":60000,"timeout_ms":10000,"max_response_bytes":65536,"tls_verify":true,"auth_token_ref":"","headers":{},"response":"text","method":"GET","body":"","static_body":"","text_path":"","reset_at_path":"$.reset_at","stale_after_ms":300000,"conditional_get":true,"max_json_depth":16}]},
{"schema":"eego.dashboard-preset/1","schema_version":1,"id":"button","kind":"panel","title":"Button","description":"One data-poll action; refresh does not force an e-paper full redraw.","dashboard":{"sources":[{"id":"metrics","kind":"http","enabled":true,"url":"http://${mock_host}/metrics","refresh_ms":60000,"timeout_ms":10000,"max_response_bytes":65536,"tls_verify":true,"auth_token_ref":"","headers":{}}],"variables":[{"name":"mock_host","label":"Mock host:port","kind":"text","default_value":"127.0.0.1:8978","options":[],"source_id":"","value_path":"","multi":false,"include_all":false}],"pages":[{"id":"main","title":"Overview","visible":true,"grid_columns":24,"panels":[{"id":"refresh_button","kind":"button","grid":{"x":0,"y":0,"w":24,"h":8},"title":"Refresh","visible":true,"refresh_ms":60000,"actions":[{"id":"refresh","kind":"refresh","label":"Refresh metrics","target":"metrics","value":"","confirm":false}]}]}],"alert_rules":[],"assets":[],"samples":[],"events":[]},"source_plans":[{"id":"metrics","kind":"http","enabled":true,"url":"http://${mock_host}/metrics","refresh_ms":60000,"timeout_ms":10000,"max_response_bytes":65536,"tls_verify":true,"auth_token_ref":"","headers":{},"response":"standard_json","method":"GET","body":"","static_body":"","text_path":"","reset_at_path":"$.reset_at","stale_after_ms":300000,"conditional_get":true,"max_json_depth":16}]},
{"schema":"eego.dashboard-preset/1","schema_version":1,"id":"button-group","kind":"panel","title":"Button group","description":"Refresh, navigation, variable, and confirmed alert acknowledgement actions.","dashboard":{"sources":[{"id":"metrics","kind":"http","enabled":true,"url":"http://${mock_host}/metrics","refresh_ms":60000,"timeout_ms":10000,"max_response_bytes":65536,"tls_verify":true,"auth_token_ref":"","headers":{}},{"id":"events","kind":"http","enabled":true,"url":"http://${mock_host}/events","refresh_ms":60000,"timeout_ms":10000,"max_response_bytes":65536,"tls_verify":true,"auth_token_ref":"","headers":{}}],"variables":[{"name":"mock_host","label":"Mock host:port","kind":"text","default_value":"127.0.0.1:8978","options":[],"source_id":"","value_path":"","multi":false,"include_all":false},{"name":"view","label":"View","kind":"constant","default_value":"compact","options":[{"label":"Compact","value":"compact"},{"label":"Detailed","value":"detailed"}],"source_id":"","value_path":"","multi":false,"include_all":false}],"pages":[{"id":"main","title":"Overview","visible":true,"grid_columns":24,"panels":[{"id":"button_group","kind":"button","grid":{"x":0,"y":0,"w":24,"h":8},"title":"Actions / ${view}","visible":true,"refresh_ms":60000,"actions":[{"id":"refresh","kind":"refresh","label":"Refresh","target":"metrics","value":"","confirm":false},{"id":"details","kind":"goto_page","label":"Events","target":"details","value":"","confirm":false},{"id":"detailed","kind":"set_variable","label":"Detailed","target":"view","value":"detailed","confirm":false},{"id":"ack","kind":"ack_alert","label":"Ack current","target":"current","value":"","confirm":true}]}]},{"id":"details","title":"Events","visible":true,"grid_columns":24,"panels":[{"id":"events","kind":"alert","grid":{"x":0,"y":0,"w":24,"h":6},"title":"Events","visible":true,"refresh_ms":60000,"text":{"content":"No alerts","multiline":false,"max_lines":1}},{"id":"back","kind":"button","grid":{"x":0,"y":6,"w":24,"h":2},"title":"Back","visible":true,"refresh_ms":60000,"actions":[{"id":"back","kind":"back","label":"Back","target":"","value":"","confirm":false}]}]}],"alert_rules":[],"assets":[],"samples":[],"events":[]},"source_plans":[{"id":"metrics","kind":"http","enabled":true,"url":"http://${mock_host}/metrics","refresh_ms":60000,"timeout_ms":10000,"max_response_bytes":65536,"tls_verify":true,"auth_token_ref":"","headers":{},"response":"standard_json","method":"GET","body":"","static_body":"","text_path":"","reset_at_path":"$.reset_at","stale_after_ms":300000,"conditional_get":true,"max_json_depth":16},{"id":"events","kind":"http","enabled":true,"url":"http://${mock_host}/events","refresh_ms":60000,"timeout_ms":10000,"max_response_bytes":65536,"tls_verify":true,"auth_token_ref":"","headers":{},"response":"standard_json","method":"GET","body":"","static_body":"","text_path":"","reset_at_path":"$.reset_at","stale_after_ms":300000,"conditional_get":true,"max_json_depth":16}]},
{"schema":"eego.dashboard-preset/1","schema_version":1,"id":"chart-kpi","kind":"layout","title":"Chart + KPI","description":"Three KPI cards above a full-width trend.","dashboard":{"sources":[{"id":"metrics","kind":"http","enabled":true,"url":"http://${mock_host}/metrics","refresh_ms":60000,"timeout_ms":10000,"max_response_bytes":65536,"tls_verify":true,"auth_token_ref":"","headers":{}}],"variables":[{"name":"mock_host","label":"Mock host:port","kind":"text","default_value":"127.0.0.1:8978","options":[],"source_id":"","value_path":"","multi":false,"include_all":false}],"pages":[{"id":"main","title":"Overview","visible":true,"grid_columns":24,"panels":[{"id":"kpi_a","kind":"card","grid":{"x":0,"y":0,"w":8,"h":3},"title":"KPI A","visible":true,"refresh_ms":60000,"source_id":"metrics","metric":"metric.value","style":{"variant":"default","precision":1}},{"id":"kpi_b","kind":"card","grid":{"x":8,"y":0,"w":8,"h":3},"title":"KPI B","visible":true,"refresh_ms":60000,"source_id":"metrics","metric":"metric.secondary","style":{"variant":"default","precision":1}},{"id":"kpi_c","kind":"card","grid":{"x":16,"y":0,"w":8,"h":3},"title":"KPI C","visible":true,"refresh_ms":60000,"source_id":"metrics","metric":"metric.tertiary","style":{"variant":"default","precision":1}},{"id":"trend","kind":"chart","grid":{"x":0,"y":3,"w":24,"h":5},"title":"Trend","visible":true,"refresh_ms":60000,"source_id":"metrics","metric":"series.value","chart":{"kind":"line","show_points":false,"fill":false,"y_min":null,"y_max":null},"style":{"unit":"","precision":1,"line_width":2,"show_legend":true},"time_window":{"from":"-1h","to":"now"}}]}],"alert_rules":[],"assets":[],"samples":[],"events":[]},"source_plans":[{"id":"metrics","kind":"http","enabled":true,"url":"http://${mock_host}/metrics","refresh_ms":60000,"timeout_ms":10000,"max_response_bytes":65536,"tls_verify":true,"auth_token_ref":"","headers":{},"response":"standard_json","method":"GET","body":"","static_body":"","text_path":"","reset_at_path":"$.reset_at","stale_after_ms":300000,"conditional_get":true,"max_json_depth":16}]},
{"schema":"eego.dashboard-preset/1","schema_version":1,"id":"chart-alerts","kind":"layout","title":"Chart + alerts","description":"Trend and alert stream side by side.","dashboard":{"sources":[{"id":"metrics","kind":"http","enabled":true,"url":"http://${mock_host}/metrics","refresh_ms":60000,"timeout_ms":10000,"max_response_bytes":65536,"tls_verify":true,"auth_token_ref":"","headers":{}},{"id":"events","kind":"http","enabled":true,"url":"http://${mock_host}/events","refresh_ms":60000,"timeout_ms":10000,"max_response_bytes":65536,"tls_verify":true,"auth_token_ref":"","headers":{}}],"variables":[{"name":"mock_host","label":"Mock host:port","kind":"text","default_value":"127.0.0.1:8978","options":[],"source_id":"","value_path":"","multi":false,"include_all":false}],"pages":[{"id":"main","title":"Overview","visible":true,"grid_columns":24,"panels":[{"id":"trend","kind":"chart","grid":{"x":0,"y":0,"w":16,"h":8},"title":"Trend","visible":true,"refresh_ms":60000,"source_id":"metrics","metric":"series.value","chart":{"kind":"line","show_points":false,"fill":false,"y_min":null,"y_max":null},"style":{"unit":"","precision":1,"line_width":2,"show_legend":true},"time_window":{"from":"-1h","to":"now"}},{"id":"alerts","kind":"alert","grid":{"x":16,"y":0,"w":8,"h":8},"title":"Alerts","visible":true,"refresh_ms":60000,"text":{"content":"No alerts","multiline":false,"max_lines":1}}]}],"alert_rules":[],"assets":[],"samples":[],"events":[]},"source_plans":[{"id":"metrics","kind":"http","enabled":true,"url":"http://${mock_host}/metrics","refresh_ms":60000,"timeout_ms":10000,"max_response_bytes":65536,"tls_verify":true,"auth_token_ref":"","headers":{},"response":"standard_json","method":"GET","body":"","static_body":"","text_path":"","reset_at_path":"$.reset_at","stale_after_ms":300000,"conditional_get":true,"max_json_depth":16},{"id":"events","kind":"http","enabled":true,"url":"http://${mock_host}/events","refresh_ms":60000,"timeout_ms":10000,"max_response_bytes":65536,"tls_verify":true,"auth_token_ref":"","headers":{},"response":"standard_json","method":"GET","body":"","static_body":"","text_path":"","reset_at_path":"$.reset_at","stale_after_ms":300000,"conditional_get":true,"max_json_depth":16}]},
{"schema":"eego.dashboard-preset/1","schema_version":1,"id":"kpi-2x2","kind":"layout","title":"2x2 KPI","description":"Four independent KPI cards in a two-by-two grid.","dashboard":{"sources":[{"id":"metrics","kind":"http","enabled":true,"url":"http://${mock_host}/metrics","refresh_ms":60000,"timeout_ms":10000,"max_response_bytes":65536,"tls_verify":true,"auth_token_ref":"","headers":{}}],"variables":[{"name":"mock_host","label":"Mock host:port","kind":"text","default_value":"127.0.0.1:8978","options":[],"source_id":"","value_path":"","multi":false,"include_all":false}],"pages":[{"id":"main","title":"Overview","visible":true,"grid_columns":24,"panels":[{"id":"kpi_a","kind":"card","grid":{"x":0,"y":0,"w":12,"h":4},"title":"KPI A","visible":true,"refresh_ms":60000,"source_id":"metrics","metric":"metric.value","style":{"variant":"default","precision":1}},{"id":"kpi_b","kind":"card","grid":{"x":12,"y":0,"w":12,"h":4},"title":"KPI B","visible":true,"refresh_ms":60000,"source_id":"metrics","metric":"metric.secondary","style":{"variant":"default","precision":1}},{"id":"kpi_c","kind":"card","grid":{"x":0,"y":4,"w":12,"h":4},"title":"KPI C","visible":true,"refresh_ms":60000,"source_id":"metrics","metric":"metric.tertiary","style":{"variant":"default","precision":1}},{"id":"kpi_d","kind":"card","grid":{"x":12,"y":4,"w":12,"h":4},"title":"Progress","visible":true,"refresh_ms":60000,"source_id":"metrics","metric":"progress.percent","style":{"variant":"progress","precision":0,"unit":"%"}}]}],"alert_rules":[],"assets":[],"samples":[],"events":[]},"source_plans":[{"id":"metrics","kind":"http","enabled":true,"url":"http://${mock_host}/metrics","refresh_ms":60000,"timeout_ms":10000,"max_response_bytes":65536,"tls_verify":true,"auth_token_ref":"","headers":{},"response":"standard_json","method":"GET","body":"","static_body":"","text_path":"","reset_at_path":"$.reset_at","stale_after_ms":300000,"conditional_get":true,"max_json_depth":16}]},
{"schema":"eego.dashboard-preset/1","schema_version":1,"id":"three-row-stack","kind":"layout","title":"Three-row information stack","description":"Summary, trend, and table in three horizontal bands.","dashboard":{"sources":[{"id":"metrics","kind":"http","enabled":true,"url":"http://${mock_host}/metrics","refresh_ms":60000,"timeout_ms":10000,"max_response_bytes":65536,"tls_verify":true,"auth_token_ref":"","headers":{}}],"variables":[{"name":"mock_host","label":"Mock host:port","kind":"text","default_value":"127.0.0.1:8978","options":[],"source_id":"","value_path":"","multi":false,"include_all":false}],"pages":[{"id":"main","title":"Overview","visible":true,"grid_columns":24,"panels":[{"id":"summary","kind":"text","grid":{"x":0,"y":0,"w":24,"h":2},"title":"Summary","visible":true,"refresh_ms":60000,"text":{"content":"Three-row information stack","multiline":true,"max_lines":2},"style":{"variant":"description"}},{"id":"trend","kind":"chart","grid":{"x":0,"y":2,"w":24,"h":3},"title":"Trend","visible":true,"refresh_ms":60000,"source_id":"metrics","metric":"series.value","chart":{"kind":"line","show_points":false,"fill":false,"y_min":null,"y_max":null},"style":{"unit":"","precision":1,"line_width":2,"show_legend":true},"time_window":{"from":"-1h","to":"now"}},{"id":"details","kind":"table","grid":{"x":0,"y":5,"w":24,"h":3},"title":"Details","visible":true,"refresh_ms":60000,"source_id":"metrics","metric":"table.value","columns":[{"key":"name","title":"Name","width":8},{"key":"value","title":"Value","width":5}],"style":{"variant":"default","precision":1}}]}],"alert_rules":[],"assets":[],"samples":[],"events":[]},"source_plans":[{"id":"metrics","kind":"http","enabled":true,"url":"http://${mock_host}/metrics","refresh_ms":60000,"timeout_ms":10000,"max_response_bytes":65536,"tls_verify":true,"auth_token_ref":"","headers":{},"response":"standard_json","method":"GET","body":"","static_body":"","text_path":"","reset_at_path":"$.reset_at","stale_after_ms":300000,"conditional_get":true,"max_json_depth":16}]},
{"schema":"eego.dashboard-preset/1","schema_version":1,"id":"comparison","kind":"layout","title":"Comparison","description":"Current and previous generic series as KPI cards and charts.","dashboard":{"sources":[{"id":"metrics","kind":"http","enabled":true,"url":"http://${mock_host}/metrics","refresh_ms":60000,"timeout_ms":10000,"max_response_bytes":65536,"tls_verify":true,"auth_token_ref":"","headers":{}}],"variables":[{"name":"mock_host","label":"Mock host:port","kind":"text","default_value":"127.0.0.1:8978","options":[],"source_id":"","value_path":"","multi":false,"include_all":false}],"pages":[{"id":"main","title":"Overview","visible":true,"grid_columns":24,"panels":[{"id":"current","kind":"card","grid":{"x":0,"y":0,"w":12,"h":3},"title":"Current","visible":true,"refresh_ms":60000,"source_id":"metrics","metric":"comparison.current","style":{"variant":"default","precision":1}},{"id":"previous","kind":"card","grid":{"x":12,"y":0,"w":12,"h":3},"title":"Previous","visible":true,"refresh_ms":60000,"source_id":"metrics","metric":"comparison.previous","style":{"variant":"default","precision":1}},{"id":"current_bars","kind":"chart","grid":{"x":0,"y":3,"w":12,"h":5},"title":"Current window","visible":true,"refresh_ms":60000,"source_id":"metrics","metric":"comparison.current","chart":{"kind":"bar","show_points":false,"fill":false,"y_min":null,"y_max":null},"style":{"unit":"","precision":1,"line_width":2,"show_legend":true},"time_window":{"from":"-1h","to":"now"}},{"id":"previous_line","kind":"chart","grid":{"x":12,"y":3,"w":12,"h":5},"title":"Previous window","visible":true,"refresh_ms":60000,"source_id":"metrics","metric":"comparison.previous","chart":{"kind":"line","show_points":false,"fill":false,"y_min":null,"y_max":null},"style":{"unit":"","precision":1,"line_width":2,"show_legend":true},"time_window":{"from":"-1h","to":"now"}}]}],"alert_rules":[],"assets":[],"samples":[],"events":[]},"source_plans":[{"id":"metrics","kind":"http","enabled":true,"url":"http://${mock_host}/metrics","refresh_ms":60000,"timeout_ms":10000,"max_response_bytes":65536,"tls_verify":true,"auth_token_ref":"","headers":{},"response":"standard_json","method":"GET","body":"","static_body":"","text_path":"","reset_at_path":"$.reset_at","stale_after_ms":300000,"conditional_get":true,"max_json_depth":16}]},
{"schema":"eego.dashboard-preset/1","schema_version":1,"id":"mosaic","kind":"layout","title":"Mosaic","description":"Six mixed panels using metrics, events, text, and image sources.","dashboard":{"sources":[{"id":"metrics","kind":"http","enabled":true,"url":"http://${mock_host}/metrics","refresh_ms":60000,"timeout_ms":10000,"max_response_bytes":65536,"tls_verify":true,"auth_token_ref":"","headers":{}},{"id":"events","kind":"http","enabled":true,"url":"http://${mock_host}/events","refresh_ms":60000,"timeout_ms":10000,"max_response_bytes":65536,"tls_verify":true,"auth_token_ref":"","headers":{}},{"id":"text","kind":"http","enabled":true,"url":"http://${mock_host}/text","refresh_ms":60000,"timeout_ms":10000,"max_response_bytes":65536,"tls_verify":true,"auth_token_ref":"","headers":{}},{"id":"image","kind":"http","enabled":true,"url":"http://${mock_host}/assets/status.png","refresh_ms":60000,"timeout_ms":10000,"max_response_bytes":65536,"tls_verify":true,"auth_token_ref":"","headers":{}}],"variables":[{"name":"mock_host","label":"Mock host:port","kind":"text","default_value":"127.0.0.1:8978","options":[],"source_id":"","value_path":"","multi":false,"include_all":false}],"pages":[{"id":"main","title":"Overview","visible":true,"grid_columns":24,"panels":[{"id":"trend","kind":"chart","grid":{"x":0,"y":0,"w":12,"h":5},"title":"Trend","visible":true,"refresh_ms":60000,"source_id":"metrics","metric":"series.value","chart":{"kind":"line","show_points":false,"fill":false,"y_min":null,"y_max":null},"style":{"unit":"","precision":1,"line_width":2,"show_legend":true},"time_window":{"from":"-1h","to":"now"}},{"id":"value","kind":"card","grid":{"x":18,"y":0,"w":6,"h":3},"title":"Value","visible":true,"refresh_ms":60000,"source_id":"metrics","metric":"metric.value","style":{"variant":"default","precision":1}},{"id":"mosaic_image","kind":"image","grid":{"x":12,"y":0,"w":6,"h":3},"title":"Image","visible":true,"refresh_ms":60000,"source_id":"image","metric":"image","image":{"asset_id":"status_image","alt_text":"No image","fit":"contain"}},{"id":"notes","kind":"text","grid":{"x":12,"y":3,"w":12,"h":2},"title":"Notes","visible":true,"refresh_ms":60000,"text":{"content":"Loading notes…","multiline":true,"max_lines":3},"style":{"variant":"multiline"},"source_id":"text","metric":"text"},{"id":"records","kind":"table","grid":{"x":0,"y":5,"w":12,"h":3},"title":"Records","visible":true,"refresh_ms":60000,"source_id":"metrics","metric":"table.value","columns":[{"key":"name","title":"Name","width":8},{"key":"value","title":"Value","width":5}],"style":{"variant":"default","precision":1}},{"id":"alerts","kind":"alert","grid":{"x":12,"y":5,"w":12,"h":3},"title":"Alerts","visible":true,"refresh_ms":60000,"text":{"content":"No alerts","multiline":false,"max_lines":1}}]}],"alert_rules":[],"assets":[{"id":"status_image","kind":"image","uri":"http://${mock_host}/assets/status.png","media_type":"image/png","sha256":"","size_bytes":0,"cache_seconds":300}],"samples":[],"events":[]},"source_plans":[{"id":"metrics","kind":"http","enabled":true,"url":"http://${mock_host}/metrics","refresh_ms":60000,"timeout_ms":10000,"max_response_bytes":65536,"tls_verify":true,"auth_token_ref":"","headers":{},"response":"standard_json","method":"GET","body":"","static_body":"","text_path":"","reset_at_path":"$.reset_at","stale_after_ms":300000,"conditional_get":true,"max_json_depth":16},{"id":"events","kind":"http","enabled":true,"url":"http://${mock_host}/events","refresh_ms":60000,"timeout_ms":10000,"max_response_bytes":65536,"tls_verify":true,"auth_token_ref":"","headers":{},"response":"standard_json","method":"GET","body":"","static_body":"","text_path":"","reset_at_path":"$.reset_at","stale_after_ms":300000,"conditional_get":true,"max_json_depth":16},{"id":"text","kind":"http","enabled":true,"url":"http://${mock_host}/text","refresh_ms":60000,"timeout_ms":10000,"max_response_bytes":65536,"tls_verify":true,"auth_token_ref":"","headers":{},"response":"text","method":"GET","body":"","static_body":"","text_path":"","reset_at_path":"$.reset_at","stale_after_ms":300000,"conditional_get":true,"max_json_depth":16},{"id":"image","kind":"http","enabled":true,"url":"http://${mock_host}/assets/status.png","refresh_ms":60000,"timeout_ms":10000,"max_response_bytes":65536,"tls_verify":true,"auth_token_ref":"","headers":{},"response":"image","method":"GET","body":"","static_body":"","text_path":"","reset_at_path":"$.reset_at","stale_after_ms":300000,"conditional_get":true,"max_json_depth":16}]}
],"examples":[
{"id":"security-events","title":"Network security events","bundle":{"schema":"eego.dashboard-bundle/1","schema_version":1,"revision":0,"dashboard":{"schema":"eego.dashboard/2","schema_version":2,"id":"security-events","title":"Network security events","default_page_id":"main","refresh_ms":60000,"sources":[{"id":"security","kind":"http","enabled":true,"url":"http://${mock_host}/security","refresh_ms":60000,"timeout_ms":10000,"max_response_bytes":65536,"tls_verify":true,"auth_token_ref":"","headers":{}}],"variables":[{"name":"mock_host","label":"Mock host:port","kind":"text","default_value":"127.0.0.1:8978","options":[],"source_id":"","value_path":"","multi":false,"include_all":false}],"pages":[{"id":"main","title":"Overview","visible":true,"grid_columns":24,"panels":[{"id":"active_alerts","kind":"card","grid":{"x":0,"y":0,"w":8,"h":3},"title":"Active alerts","visible":true,"refresh_ms":60000,"source_id":"security","metric":"security.alerts.active","style":{"variant":"default","precision":0},"thresholds":[{"value":1,"severity":"warning","label":"Active"},{"value":5,"severity":"critical","label":"High"}]},{"id":"blocked","kind":"card","grid":{"x":8,"y":0,"w":8,"h":3},"title":"Blocked","visible":true,"refresh_ms":60000,"source_id":"security","metric":"security.blocked","style":{"variant":"default","precision":0}},{"id":"failed_logins","kind":"card","grid":{"x":16,"y":0,"w":8,"h":3},"title":"Failed logins","visible":true,"refresh_ms":60000,"source_id":"security","metric":"security.failed_logins","style":{"variant":"default","precision":0}},{"id":"security_events","kind":"alert","grid":{"x":0,"y":3,"w":24,"h":4},"title":"Network security events","visible":true,"refresh_ms":60000,"text":{"content":"No alerts","multiline":false,"max_lines":1}},{"id":"security_actions","kind":"button","grid":{"x":0,"y":7,"w":24,"h":1},"title":"Actions","visible":true,"refresh_ms":60000,"actions":[{"id":"refresh","kind":"refresh","label":"Refresh","target":"security","value":"","confirm":false},{"id":"ack","kind":"ack_alert","label":"Ack current","target":"current","value":"","confirm":true}]}]}],"alert_rules":[],"assets":[],"samples":[],"events":[]},"source_plans":[{"id":"security","kind":"http","enabled":true,"url":"http://${mock_host}/security","refresh_ms":60000,"timeout_ms":10000,"max_response_bytes":65536,"tls_verify":true,"auth_token_ref":"","headers":{},"response":"standard_json","method":"GET","body":"","static_body":"","text_path":"","reset_at_path":"$.reset_at","stale_after_ms":300000,"conditional_get":true,"max_json_depth":16}]}},
{"id":"server-metrics","title":"Server CPU and memory","bundle":{"schema":"eego.dashboard-bundle/1","schema_version":1,"revision":0,"dashboard":{"schema":"eego.dashboard/2","schema_version":2,"id":"server-metrics","title":"Server CPU and memory","default_page_id":"main","refresh_ms":60000,"sources":[{"id":"server","kind":"http","enabled":true,"url":"http://${mock_host}/server?host=${server_name}","refresh_ms":60000,"timeout_ms":10000,"max_response_bytes":65536,"tls_verify":true,"auth_token_ref":"","headers":{}}],"variables":[{"name":"mock_host","label":"Mock host:port","kind":"text","default_value":"127.0.0.1:8978","options":[],"source_id":"","value_path":"","multi":false,"include_all":false},{"name":"server_name","label":"Server","kind":"constant","default_value":"srv-demo","options":[{"label":"Demo server","value":"srv-demo"},{"label":"Backup server","value":"srv-backup"}],"source_id":"","value_path":"","multi":false,"include_all":false}],"pages":[{"id":"main","title":"Overview","visible":true,"grid_columns":24,"panels":[{"id":"cpu","kind":"card","grid":{"x":0,"y":0,"w":12,"h":3},"title":"CPU / ${server_name}","visible":true,"refresh_ms":60000,"source_id":"server","metric":"server.cpu","style":{"variant":"default","precision":1,"unit":"%"},"thresholds":[{"value":80,"severity":"warning","label":"High"},{"value":95,"severity":"critical","label":"Critical"}]},{"id":"memory","kind":"card","grid":{"x":12,"y":0,"w":12,"h":3},"title":"Memory","visible":true,"refresh_ms":60000,"source_id":"server","metric":"server.memory","style":{"variant":"default","precision":1,"unit":"%"},"thresholds":[{"value":85,"severity":"warning","label":"High"},{"value":95,"severity":"critical","label":"Critical"}]},{"id":"cpu_chart","kind":"chart","grid":{"x":0,"y":3,"w":12,"h":4},"title":"CPU window","visible":true,"refresh_ms":60000,"source_id":"server","metric":"server.cpu","chart":{"kind":"line","show_points":false,"fill":false,"y_min":0,"y_max":100},"style":{"unit":"%","precision":1,"line_width":2},"time_window":{"from":"-1h","to":"now"}},{"id":"memory_chart","kind":"chart","grid":{"x":12,"y":3,"w":12,"h":4},"title":"Memory window","visible":true,"refresh_ms":60000,"source_id":"server","metric":"server.memory","chart":{"kind":"line","show_points":false,"fill":true,"y_min":0,"y_max":100},"style":{"unit":"%","precision":1,"line_width":2},"time_window":{"from":"-1h","to":"now"}},{"id":"server_details_button","kind":"button","grid":{"x":0,"y":7,"w":24,"h":1},"title":"Details","visible":true,"refresh_ms":60000,"actions":[{"id":"details","kind":"goto_page","label":"Details","target":"details","value":"","confirm":false}]}]},{"id":"details","title":"Server details","visible":true,"grid_columns":24,"panels":[{"id":"server_status","kind":"table","grid":{"x":0,"y":0,"w":24,"h":4},"title":"Server status","visible":true,"refresh_ms":60000,"source_id":"server","metric":"server.health","columns":[{"key":"name","title":"Server","width":10},{"key":"value","title":"Health","width":4},{"key":"status","title":"State","width":8}],"style":{"variant":"status_grid","precision":0},"thresholds":[{"value":1,"severity":"warning","label":"Degraded"},{"value":2,"severity":"critical","label":"Down"}]},{"id":"server_table","kind":"table","grid":{"x":0,"y":4,"w":24,"h":3},"title":"CPU samples","visible":true,"refresh_ms":60000,"source_id":"server","metric":"server.cpu","columns":[{"key":"name","title":"Server","width":8},{"key":"value","title":"CPU %","width":5},{"key":"timestamp_ms","title":"Timestamp","width":10}],"style":{"precision":1}},{"id":"server_actions","kind":"button","grid":{"x":0,"y":7,"w":24,"h":1},"title":"Actions","visible":true,"refresh_ms":60000,"actions":[{"id":"back","kind":"back","label":"Back","target":"","value":"","confirm":false},{"id":"refresh","kind":"refresh","label":"Refresh","target":"server","value":"","confirm":false}]}]}],"alert_rules":[{"id":"cpu_high","title":"High CPU","enabled":true,"source_id":"server","metric":"server.cpu","expression":"value > 80","for_ms":0,"message":"CPU exceeds 80 percent","style":{"surfaces":["banner","card","table_row"],"severity":"warning","linked_panel_id":"cpu"}}],"assets":[],"samples":[],"events":[]},"source_plans":[{"id":"server","kind":"http","enabled":true,"url":"http://${mock_host}/server?host=${server_name}","refresh_ms":60000,"timeout_ms":10000,"max_response_bytes":65536,"tls_verify":true,"auth_token_ref":"","headers":{},"response":"standard_json","method":"GET","body":"","static_body":"","text_path":"","reset_at_path":"$.reset_at","stale_after_ms":300000,"conditional_get":true,"max_json_depth":16}]}},
{"id":"token-usage","title":"TOKEN usage","bundle":{"schema":"eego.dashboard-bundle/1","schema_version":1,"revision":0,"dashboard":{"schema":"eego.dashboard/2","schema_version":2,"id":"token-usage","title":"TOKEN usage","default_page_id":"main","refresh_ms":60000,"sources":[{"id":"token","kind":"http","enabled":true,"url":"http://${mock_host}/token?account=${account}","refresh_ms":60000,"timeout_ms":10000,"max_response_bytes":65536,"tls_verify":true,"auth_token_ref":"","headers":{}}],"variables":[{"name":"mock_host","label":"Mock host:port","kind":"text","default_value":"127.0.0.1:8978","options":[],"source_id":"","value_path":"","multi":false,"include_all":false},{"name":"account","label":"Account","kind":"constant","default_value":"demo-account","options":[{"label":"Demo account","value":"demo-account"},{"label":"Secondary account","value":"secondary-account"}],"source_id":"","value_path":"","multi":false,"include_all":false}],"pages":[{"id":"main","title":"Overview","visible":true,"grid_columns":24,"panels":[{"id":"token_used","kind":"card","grid":{"x":0,"y":0,"w":12,"h":4},"title":"TOKEN used / ${account}","visible":true,"refresh_ms":60000,"source_id":"token","metric":"token.used","style":{"variant":"default","precision":0,"unit":"tokens"},"thresholds":[{"value":80000,"severity":"warning","label":"High"},{"value":95000,"severity":"critical","label":"Near quota"}]},{"id":"token_remaining","kind":"card","grid":{"x":12,"y":0,"w":12,"h":4},"title":"TOKEN remaining","visible":true,"refresh_ms":60000,"source_id":"token","metric":"token.remaining","style":{"variant":"progress","precision":0,"unit":"%","invert":true},"thresholds":[{"value":20,"severity":"warning","label":"Low"},{"value":10,"severity":"critical","label":"Exhausted"}]},{"id":"token_trend","kind":"chart","grid":{"x":0,"y":4,"w":16,"h":4},"title":"TOKEN window","visible":true,"refresh_ms":60000,"source_id":"token","metric":"token.used","chart":{"kind":"line","show_points":false,"fill":true,"y_min":0,"y_max":null},"style":{"unit":"tokens","precision":0,"line_width":2},"time_window":{"from":"-5h","to":"now"}},{"id":"token_actions","kind":"button","grid":{"x":16,"y":4,"w":8,"h":4},"title":"Actions","visible":true,"refresh_ms":60000,"actions":[{"id":"refresh","kind":"refresh","label":"Refresh","target":"token","value":"","confirm":false},{"id":"details","kind":"goto_page","label":"Details","target":"details","value":"","confirm":false}]}]},{"id":"details","title":"TOKEN details","visible":true,"grid_columns":24,"panels":[{"id":"token_table","kind":"table","grid":{"x":0,"y":0,"w":24,"h":6},"title":"TOKEN metrics","visible":true,"refresh_ms":60000,"source_id":"token","metric":"token.used","columns":[{"key":"value","title":"Used","unit":"tokens","width":6},{"key":"account","title":"Account","width":10},{"key":"timestamp_ms","title":"Timestamp","width":10}],"style":{"precision":0}},{"id":"back","kind":"button","grid":{"x":0,"y":6,"w":24,"h":2},"title":"Back","visible":true,"refresh_ms":60000,"actions":[{"id":"back","kind":"back","label":"Back","target":"","value":"","confirm":false}]}]}],"alert_rules":[{"id":"token_quota","title":"TOKEN quota","enabled":true,"source_id":"token","metric":"token.used","expression":"value > 80000","for_ms":0,"message":"TOKEN usage exceeds the configured example threshold","style":{"surfaces":["banner","card","table_row"],"severity":"warning","linked_panel_id":"token_used"}}],"assets":[],"samples":[],"events":[]},"source_plans":[{"id":"token","kind":"http","enabled":true,"url":"http://${mock_host}/token?account=${account}","refresh_ms":60000,"timeout_ms":10000,"max_response_bytes":65536,"tls_verify":true,"auth_token_ref":"","headers":{},"response":"standard_json","method":"GET","body":"","static_body":"","text_path":"","reset_at_path":"$.reset_at","stale_after_ms":300000,"conditional_get":true,"max_json_depth":16}]}},
{"id":"weather","title":"Weather","bundle":{"schema":"eego.dashboard-bundle/1","schema_version":1,"revision":0,"dashboard":{"schema":"eego.dashboard/2","schema_version":2,"id":"weather","title":"Weather","default_page_id":"main","refresh_ms":60000,"sources":[{"id":"weather","kind":"http","enabled":true,"url":"http://${mock_host}/weather?city=${city}","refresh_ms":60000,"timeout_ms":10000,"max_response_bytes":65536,"tls_verify":true,"auth_token_ref":"","headers":{}},{"id":"weather_image","kind":"http","enabled":true,"url":"http://${mock_host}/assets/weather.png","refresh_ms":60000,"timeout_ms":10000,"max_response_bytes":65536,"tls_verify":true,"auth_token_ref":"","headers":{}}],"variables":[{"name":"mock_host","label":"Mock host:port","kind":"text","default_value":"127.0.0.1:8978","options":[],"source_id":"","value_path":"","multi":false,"include_all":false},{"name":"city","label":"City","kind":"constant","default_value":"Shanghai","options":[{"label":"Shanghai","value":"Shanghai"},{"label":"Shenzhen","value":"Shenzhen"}],"source_id":"","value_path":"","multi":false,"include_all":false}],"pages":[{"id":"main","title":"Overview","visible":true,"grid_columns":24,"panels":[{"id":"temperature","kind":"card","grid":{"x":0,"y":0,"w":8,"h":4},"title":"Temperature / ${city}","visible":true,"refresh_ms":60000,"source_id":"weather","metric":"weather.temperature","style":{"variant":"default","precision":1,"unit":"C"}},{"id":"humidity","kind":"card","grid":{"x":8,"y":0,"w":8,"h":4},"title":"Humidity","visible":true,"refresh_ms":60000,"source_id":"weather","metric":"weather.humidity","style":{"variant":"default","precision":0,"unit":"%"}},{"id":"wind","kind":"card","grid":{"x":16,"y":0,"w":8,"h":4},"title":"Wind","visible":true,"refresh_ms":60000,"source_id":"weather","metric":"weather.wind_speed","style":{"variant":"default","precision":1,"unit":"km/h"}},{"id":"weather_chart","kind":"chart","grid":{"x":0,"y":4,"w":16,"h":4},"title":"Temperature window","visible":true,"refresh_ms":60000,"source_id":"weather","metric":"weather.temperature","chart":{"kind":"line","show_points":true,"fill":true,"y_min":null,"y_max":null},"style":{"unit":"C","precision":1,"line_width":2},"time_window":{"from":"-5h","to":"now"}},{"id":"weather_image_panel","kind":"image","grid":{"x":16,"y":4,"w":8,"h":4},"title":"Conditions","visible":true,"refresh_ms":60000,"source_id":"weather_image","metric":"image","image":{"asset_id":"weather_image","alt_text":"Weather image unavailable","fit":"contain"}}]}],"alert_rules":[],"assets":[{"id":"weather_image","kind":"image","uri":"http://${mock_host}/assets/weather.png","media_type":"image/png","sha256":"","size_bytes":0,"cache_seconds":900}],"samples":[],"events":[]},"source_plans":[{"id":"weather","kind":"http","enabled":true,"url":"http://${mock_host}/weather?city=${city}","refresh_ms":60000,"timeout_ms":10000,"max_response_bytes":65536,"tls_verify":true,"auth_token_ref":"","headers":{},"response":"standard_json","method":"GET","body":"","static_body":"","text_path":"","reset_at_path":"$.reset_at","stale_after_ms":300000,"conditional_get":true,"max_json_depth":16},{"id":"weather_image","kind":"http","enabled":true,"url":"http://${mock_host}/assets/weather.png","refresh_ms":60000,"timeout_ms":10000,"max_response_bytes":65536,"tls_verify":true,"auth_token_ref":"","headers":{},"response":"image","method":"GET","body":"","static_body":"","text_path":"","reset_at_path":"$.reset_at","stale_after_ms":300000,"conditional_get":true,"max_json_depth":16}]}}
]})EEGOTPL";
