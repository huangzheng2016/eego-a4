## firmware/sdkconfig.defaults
```kconfig
CONFIG_IDF_TARGET="esp32s3"

# Flash: 16MB DIO 80MHz
CONFIG_ESPTOOLPY_FLASHMODE_DIO=y
CONFIG_ESPTOOLPY_FLASHSIZE_16MB=y
CONFIG_ESPTOOLPY_FLASHFREQ_80M=y

CONFIG_PARTITION_TABLE_CUSTOM=y
CONFIG_PARTITION_TABLE_CUSTOM_FILENAME="partitions.csv"
CONFIG_PARTITION_TABLE_FILENAME="partitions.csv"

# PSRAM: Octal 80MHz
CONFIG_SPIRAM=y
CONFIG_SPIRAM_MODE_OCT=y
CONFIG_SPIRAM_SPEED_80M=y
CONFIG_SPIRAM_USE_MALLOC=y
CONFIG_SPIRAM_MALLOC_ALWAYSINTERNAL=4096
CONFIG_SPIRAM_MALLOC_RESERVE_INTERNAL=65536
# CONFIG_SPIRAM_TRY_ALLOCATE_WIFI_LWIP is not set

CONFIG_FATFS_LFN_HEAP=y
CONFIG_FATFS_API_ENCODING_UTF_8=y
CONFIG_FATFS_CODEPAGE_437=y
CONFIG_FATFS_MAX_LFN=255

CONFIG_ESP_WIFI_ENABLED=y
CONFIG_ESP_PHY_MAX_WIFI_TX_POWER=20
CONFIG_ESP_WIFI_11KV_SUPPORT=y
CONFIG_ESP_WIFI_RRM_SUPPORT=y
CONFIG_ESP_WIFI_WNM_SUPPORT=y
# CONFIG_ESP_WIFI_NVS_ENABLED is not set
# CONFIG_ESP_WIFI_IRAM_OPT is not set
# CONFIG_ESP_WIFI_RX_IRAM_OPT is not set

CONFIG_BT_ENABLED=y
CONFIG_BT_NIMBLE_ENABLED=y
# CONFIG_BT_BLUEDROID_ENABLED is not set
CONFIG_BT_CONTROLLER_ENABLED=y
CONFIG_ESP_COEX_SW_COEXIST_ENABLE=y
CONFIG_BT_NIMBLE_MEM_ALLOC_MODE_EXTERNAL=y
CONFIG_BT_NIMBLE_LOG_LEVEL_WARNING=y
CONFIG_BT_NIMBLE_MAX_CONNECTIONS=1
CONFIG_BT_NIMBLE_MAX_BONDS=4
CONFIG_BT_NIMBLE_MAX_CCCDS=8
CONFIG_BT_CTRL_BLE_MAX_ACT=3
CONFIG_BT_NIMBLE_ROLE_PERIPHERAL=y
CONFIG_BT_NIMBLE_ROLE_BROADCASTER=y
CONFIG_BT_NIMBLE_ROLE_OBSERVER=y
# CONFIG_BT_NIMBLE_ROLE_CENTRAL is not set
# CONFIG_BT_NIMBLE_GATT_CLIENT is not set
# CONFIG_BT_NIMBLE_EXT_ADV is not set
# CONFIG_BT_NIMBLE_EXT_SCAN is not set
# CONFIG_BT_NIMBLE_ENABLE_PERIODIC_ADV is not set
# CONFIG_BT_NIMBLE_ENABLE_PERIODIC_SYNC is not set
CONFIG_BT_NIMBLE_MSYS_1_BLOCK_COUNT=24
CONFIG_BT_NIMBLE_MSYS_2_BLOCK_COUNT=16
CONFIG_BT_NIMBLE_TRANSPORT_ACL_FROM_LL_COUNT=16
CONFIG_BT_NIMBLE_TRANSPORT_EVT_COUNT=24
CONFIG_BT_NIMBLE_HOST_QUEUE_CONG_CHECK=y
CONFIG_BT_NIMBLE_NVS_PERSIST=y
CONFIG_BT_NIMBLE_SMP_ID_RESET=y
# CONFIG_BT_NIMBLE_PROX_SERVICE is not set
# CONFIG_BT_NIMBLE_ANS_SERVICE is not set
# CONFIG_BT_NIMBLE_CTS_SERVICE is not set
# CONFIG_BT_NIMBLE_HTP_SERVICE is not set
# CONFIG_BT_NIMBLE_IPSS_SERVICE is not set
# CONFIG_BT_NIMBLE_TPS_SERVICE is not set
# CONFIG_BT_NIMBLE_IAS_SERVICE is not set
# CONFIG_BT_NIMBLE_LLS_SERVICE is not set
# CONFIG_BT_NIMBLE_SPS_SERVICE is not set
# CONFIG_BT_NIMBLE_HR_SERVICE is not set
# CONFIG_BT_NIMBLE_BAS_SERVICE is not set
# CONFIG_BT_NIMBLE_DIS_SERVICE is not set
CONFIG_BT_NIMBLE_ATT_PREFERRED_MTU=512
CONFIG_BT_NIMBLE_HOST_TASK_STACK_SIZE=6144
# CONFIG_BT_NIMBLE_SM_LEGACY is not set
CONFIG_BT_NIMBLE_SM_SC=y
CONFIG_BT_NIMBLE_SM_SC_ONLY=1
CONFIG_BT_NIMBLE_SVC_GAP_DEVICE_NAME="EEGO-A4"
CONFIG_LWIP_NETIF_LOOPBACK=y

CONFIG_ESP_HTTP_CLIENT_ENABLE_HTTPS=y
CONFIG_MBEDTLS_CERTIFICATE_BUNDLE=y
CONFIG_MBEDTLS_CERTIFICATE_BUNDLE_DEFAULT_FULL=y

CONFIG_LWIP_TCPIP_TASK_STACK_SIZE=8192

CONFIG_LWIP_MAX_SOCKETS=16

CONFIG_ESP_SYSTEM_EVENT_TASK_STACK_SIZE=8192

CONFIG_ESP_MAIN_TASK_STACK_SIZE=32768

CONFIG_ESP_CONSOLE_USB_SERIAL_JTAG=y
CONFIG_ESP_CONSOLE_UART_BAUDRATE=115200

# SPI master
CONFIG_SPI_MASTER_ISR_IN_IRAM=y

# I2C
CONFIG_I2C_ENABLE_DEBUG_LOG=n

CONFIG_BOOTLOADER_APP_ROLLBACK_ENABLE=y

CONFIG_ESP_COREDUMP_ENABLE_TO_FLASH=y
CONFIG_ESP_COREDUMP_DATA_FORMAT_ELF=y
```
